## conf/layer.conf
```bitbake
BBPATH .= ":${LAYERDIR}"

# We have a recipes directory containing .bb and .bbappend files, add to BBFILES
BBFILES += "${LAYERDIR}/recipes*/*/*.bb \
            ${LAYERDIR}/recipes*/*/*.bbappend"

BBFILE_COLLECTIONS += "iot-hub-device-update"
BBFILE_PATTERN_iot-hub-device-update = "^${LAYERDIR}/"

# Pri 16 ensures that our recipes are applied over other layers.
# This is applicable where we are using appends files to adjust other recipes.
BBFILE_PRIORITY_iot-hub-device-update = "16"
LAYERDEPENDS_iot-hub-device-update = "swupdate"
LAYERSERIES_COMPAT_iot-hub-device-update  = "warrior zeus dunfell gatesgarth"

# Layer-specific configuration variables.
MODEL_NAME ?= "raspberrypi3"
HW_REV ?= "1.0"

MANUFACTURER ?= "UWINGS TECH"
MODEL ?= "ADU Raspberry Pi Example"

ADU_HW_COMPAT ?= "${MODEL_NAME} ${HW_REV}"
ADU_SOFTWARE_VERSION ?= "0.0.1"

ADUC_PUBLIC_KEY ?= "${TOPDIR}/../keys/public.pem"

BBFILES += "${@' '.join('${LAYERDIR}/%s/recipes*/*/*.%s' % (layer, ext) \
               for layer in '${BBFILE_COLLECTIONS}'.split() for ext in ['bb', 'bbappend'])}"
```

## recipes-support/swupdate/swupdate/defconfig
```kconfig
CONFIG_HAVE_DOT_CONFIG=y

#
# General Configuration
#
# CONFIG_MTD is not set
# CONFIG_CURL is not set
# CONFIG_CURL_SSL is not set
CONFIG_SYSTEMD=y
CONFIG_DEFAULT_CONFIG_FILE="/etc/swupdate.cfg"
CONFIG_SCRIPTS=y
CONFIG_HW_COMPATIBILITY=y
CONFIG_HW_COMPATIBILITY_FILE="/etc/adu-hw-compat"

#
# Socket Paths
#
CONFIG_LUA=y
CONFIG_LUAPKG="lua"
# CONFIG_FEATURE_SYSLOG is not set

#
# Build Options
#
CONFIG_CROSS_COMPILE=""
CONFIG_SYSROOT=""
CONFIG_EXTRA_CFLAGS=""
CONFIG_EXTRA_LDFLAGS=""
CONFIG_EXTRA_LDLIBS=""

CONFIG_UBOOT=y
CONFIG_UBOOT_NEWAPI=y
CONFIG_UBOOT_FWENV="/etc/fw_env.config"
CONFIG_HASH_VERIFY=y
CONFIG_SIGNED_IMAGES=y
CONFIG_SIGALG_RAWRSA=y

CONFIG_GUNZIP=y
CONFIG_ZSTD=y

#
# embedded web server
#
CONFIG_WEBSERVER=y
CONFIG_MONGOOSESSL=y

#
#Parser Features
#
CONFIG_LIBCONFIG=y
CONFIG_PARSERROOT=""

#
# Image Handler
#
CONFIG_RAW=y
CONFIG_ARCHIVE=y
CONFIG_BOOTLOADERHANDLER=y
CONFIG_RDIFFHANDLER=y
CONFIG_LUASCRIPTHANDLER=y
CONFIG_SHELLSCRIPTHANDLER=y
CONFIG_HANDLER_IN_LUA=y
CONFIG_REMOTE_HANDLER=y
```
